//////////////////////////////////////////////////////////////////////////////
//
// Linker command file for SiLab C8051F300
//
//////////////////////////////////////////////////////////////////////////////


-D_NR_OF_VIRTUAL_REGISTERS=8
-D_CODEBANK_START=0
-D_CODEBANK_END=0
-D_IDATA_STACK_SIZE=0x40
-D_EXTENDED_STACK_START=0x00
-D_EXTENDED_STACK_END=0x00
-D_EXTENDED_STACK_SIZE=0x00
-D_PDATA_STACK_SIZE=0x0
-D_XDATA_STACK_SIZE=0x0
-D_XDATA_HEAP_SIZE=0x0
-D_FAR_HEAP_SIZE=0x0
-D_HUGE_HEAP_SIZE=0x0

// Segment limits
// --------------
-D_PDATA_START=0x0300 // First address for PDATA memory.
-D_PDATA_END=0x03FF   // Last address for PDATA memory.
-D_IXDATA_START=0     // First address of on chip XDATA memory.
-D_IXDATA_END=0       // Last address of on chip XDATA memory.
-D_XDATA_START=0x0    // First address of XDATA memory.
-D_XDATA_END=0x0      // Last address of XDATA memory.
-D_IDATA_END=0xFF     // Last address of Idata memory

// Special SFRs
// ------------
-D?REGISTER_BANK=0    // Default register bank (0,1,2,3).
-D_REGISTER_BANK_START=0 // Start address for default register bank (00,08,10,18).
-D?PBANK_NUMBER=0F	  // high byte of 16-bit address to the PDATA area
-D?PBANK=A0           // Most significant byte in MOVX A,@R0. (0xA0 is sfr P2)
-D?PBANK_EXT=0xEA     // Most significant byte in MOVX A,@R0. (DS80C390: 0xEA)
-D?VB=20              // Used to refer to BREG as byte.
-D_FIRST_BANK_ADDR=0x10000
-D_NR_OF_BANKS=0x10


// The Silab F30x chip has 8KB flash memory in the range CODE:0x0000-0x2000,
// from which 0x0000-0x1DFF is available to the applications
// --------------
-D_CODE_START=0x0000  // First address for CODE.
-D_CODE_END=0x1DFF    // Last address for CODE.

-D_FAR_DATA_NR_OF_BANKS=0   // Number of banks in far data memory.
-D_FAR_DATA_START=0   // First address of far memory.
-D_FAR_DATA_END=0     // Last address of far memory.
-D_FAR_CODE_START=_CODE_START  // First address for far code.
-D_FAR_CODE_END=_CODE_END      // Last address for far code.

//////////////////////////////////////////////////////////////////////////////
//
// IDATA memory
//

// Setup "bit" segments (only for '__no_init bool' variables).
-Z(BIT)BREG=0-7
-Z(BIT)BIT_N=0-7F

-Z(DATA)REGISTERS+8=_REGISTER_BANK_START
-Z(DATA)BDATA_Z,BDATA_N,BDATA_I=20-2F
-Z(DATA)VREG+_NR_OF_VIRTUAL_REGISTERS=08-7F
-Z(DATA)PSP,XSP=08-7F
-Z(DATA)DOVERLAY=08-7F
-Z(DATA)DATA_I,DATA_Z,DATA_N=08-7F

-U(IDATA)0-7F=(DATA)0-7F
-Z(IDATA)IDATA_I,IDATA_Z,IDATA_N=08-_IDATA_END
-Z(IDATA)ISTACK+_IDATA_STACK_SIZE#08-_IDATA_END
-Z(IDATA)IOVERLAY=08-FF

//////////////////////////////////////////////////////////////////////////////
//
// ROM memory
//

// Note: INTVEC must be placed first.
// Note: CSTART Must be located in first 64k.

//
// Program memory
//
-Z(CODE)INTVEC=0
-Z(CODE)CSTART=_CODE_START-_CODE_END
-Z(CODE)RCODE=_CODE_START-_CODE_END
-Z(CODE)TINY_CODE=_CODE_START-_CODE_END
-Z(CODE)NEAR_CODE=_CODE_START-_CODE_END
-Z(CODE)DIFUNCT=_CODE_START-_CODE_END
-Z(CODE)FAR_CODE=_CODE_START-_CODE_END

//  Setup bank-switched segments.
-P(CODE)BANKED_CODE=[(_CODEBANK_START+_FIRST_BANK_ADDR)-(_CODEBANK_END+_FIRST_BANK_ADDR)]*_NR_OF_BANKS+10000


//
// Initializers
//
-Z(CODE)BIT_ID,BDATA_ID,DATA_ID,IDATA_ID,IXDATA_ID,PDATA_ID,XDATA_ID=_CODE_START-_CODE_END
-Z(CODE)HUGE_ID=_FAR_CODE_START-_FAR_CODE_END

//
// Constants located in code memory
//
-Z(CODE)CODE_C=_CODE_START-_CODE_END
-Z(CODE)FAR_CODE_C=_FAR_CODE_START-_FAR_CODE_END
-Z(CODE)HUGE_CODE_C=_FAR_CODE_START-_FAR_CODE_END

////////////////////////////////////////////////////////////////////////////////
//
// XDATA memory
//

//
// Stacks located in XDATA
//
-Z(XDATA)EXT_STACK+_EXTENDED_STACK_SIZE=_EXTENDED_STACK_START-_EXTENDED_STACK_END
-Z(XDATA)PSTACK+_PDATA_STACK_SIZE=_PDATA_START-_PDATA_END
-Z(XDATA)XSTACK+_XDATA_STACK_SIZE=_XDATA_START-_XDATA_END

//
// PDATA - data memory
//
-Z(XDATA)PDATA_N,PDATA_Z,PDATA_I=_PDATA_START-_PDATA_END

//
// XDATA - data memory
//
-Z(XDATA)IXDATA_N,IXDATA_Z,IXDATA_I=_IXDATA_START-_IXDATA_END
-Z(XDATA)XDATA_N,XDATA_Z,XDATA_I=_XDATA_START-_XDATA_END
-Z(XDATA)XDATA_HEAP+_XDATA_HEAP_SIZE=_XDATA_START-_XDATA_END
-Z(CONST)XDATA_ROM_C=_XDATA_START-_XDATA_END

//
// FAR - extended data memory
//

// initialized FAR data
// Note: The segment FAR_I and FAR_ID must start at the same address within
// a 64k bank, they must therefore be located first in the FAR data area,
// and in the xlink linker file.
//
// Note: *_I segment is located in RAM but *_ID segments is located in ROM

-Z(SPLIT-XDATA)FAR_Z=[_FAR_DATA_START-_FAR_DATA_END]/10000
-Z(SPLIT-XDATA)FAR_I=[_FAR_DATA_START-_FAR_DATA_END]/10000
-Z(SPLIT-CODE)FAR_ID=[_FAR_CODE_START-_FAR_CODE_END]/10000
-Z(SPLIT-XDATA)FAR_HEAP+_FAR_HEAP_SIZE=[_FAR_DATA_START-_FAR_DATA_END]/10000
-P(XDATA)FAR_N=[_FAR_DATA_START-_FAR_DATA_END]*_FAR_DATA_NR_OF_BANKS+10000
-P(CONST)FAR_ROM_C=[_FAR_DATA_START-_FAR_DATA_END]*E+10000

//
// HUGE - extended data memory
//
-Z(XDATA)HUGE_N,HUGE_Z,HUGE_I=_FAR_DATA_START-_FAR_DATA_END
-Z(XDATA)HUGE_HEAP+_HUGE_HEAP_SIZE=_FAR_DATA_START-_FAR_DATA_END
-Z(CONST)HUGE_ROM_C=_FAR_DATA_START-_FAR_DATA_END

-cx51
